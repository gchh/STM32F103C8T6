/**
  ******************************************************************************
  * 文件名程: main.c 
  * 作    者: 
  * 版    本: V1.0
  * 编写日期: 
  * 功    能: KXCJ9-1008加速度传感器
  ******************************************************************************
  * 说明：
  * 
  * 
  ******************************************************************************
  */

/* 包含头文件 ----------------------------------------------------------------*/
#include "stm32f10x.h"
#include "stm32f10x_it.h"
#include "bsp/usart/bsp_debug_usart.h"
#include "bsp/systick/bsp_SysTick.h"
#include "bsp/led/bsp_led.h"
#include "bsp/I2C/bsp_i2c.h"
#include "bsp/kxcj9/kxcj9.h"
/* 私有类型定义 --------------------------------------------------------------*/
/* 私有宏定义 ----------------------------------------------------------------*/
#define TASK_ENABLE 0

/* 私有变量 ------------------------------------------------------------------*/
/* 扩展变量 ------------------------------------------------------------------*/
extern unsigned int Task_Delay[NumOfTask];
unsigned char i;
int8_t x,y,z;

/* 私有函数原形 --------------------------------------------------------------*/
/* 函数体 --------------------------------------------------------------------*/
/**
  * 函数功能: 主函数.
  * 输入参数: 无
  * 返 回 值: 无
  * 说    明: 无
  */
int main(void)
{
	//int8_t Accel[3];
    short Accel[3];
    
	// LED 端口初始化 
	LED_GPIO_Init();
	// 串口1通信初始化 
	DEBUG_USART_Init();
	//I2C初始化
	i2c_CfgGpio();  
    //初始化systick
    SysTick_Init();  
  
    //KXCJ9初始化
    KXCJ9_Init();

	//检测KXCJ9
	if (KXCJ9ReadID() == 0)
	{	
        printf("检测不到KXCJ9，停机");
        while(1);
    }

    while(1)
    {
        if(Task_Delay[0]==TASK_ENABLE)
        {
            LED1_TOGGLE;
            Task_Delay[0]=1000;
        }      
      
        if(Task_Delay[1]==0)
        {
            //KXCJ9ReadAcc8Bit(Accel);
            KXCJ9ReadAcc12Bit(Accel);			
            printf("\r\n加速度： %8d%8d%8d    ",Accel[0],Accel[1],Accel[2]);        
        
            Task_Delay[1]=100;//此值每1ms会减1，减到0才可以重新进来这里，所以执行的周期是100ms
        }
    }   
}


/******************* (C) COPYRIGHT 2015-2020 硬石嵌入式开发团队 *****END OF FILE****/
